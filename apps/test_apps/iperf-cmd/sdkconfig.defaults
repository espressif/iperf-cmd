## apps/test_apps/iperf-cmd/sdkconfig.defaults
```kconfig
CONFIG_FREERTOS_HZ=1000
CONFIG_LWIP_IPV4=y
CONFIG_LWIP_IPV6=y
CONFIG_LWIP_IRAM_OPTIMIZATION=y
CONFIG_LWIP_EXTRA_IRAM_OPTIMIZATION=y
CONFIG_ESP_TASK_WDT_TIMEOUT_S=60

# Set fixed TCP/UDP buffer sizes for consistent loopback performance testing
CONFIG_IPERF_DEF_TCP_TX_BUFFER_LEN=16384
CONFIG_IPERF_DEF_TCP_RX_BUFFER_LEN=16384
CONFIG_IPERF_DEF_IPV4_UDP_TX_BUFFER_LEN=1470
CONFIG_IPERF_DEF_IPV6_UDP_TX_BUFFER_LEN=1450
CONFIG_IPERF_DEF_UDP_RX_BUFFER_LEN=16384
```

## apps/test_apps/loopback/sdkconfig.defaults
```kconfig
CONFIG_UNITY_ENABLE_FIXTURE=y
CONFIG_UNITY_ENABLE_IDF_TEST_RUNNER=y

# Disable watch dog
CONFIG_ESP_INT_WDT=n
CONFIG_ESP_TASK_WDT_EN=n
CONFIG_ESP_TASK_WDT=n

# Enable lwIP IRAM optimization
CONFIG_LWIP_IRAM_OPTIMIZATION=y
```

## iperf-cmd/Kconfig
```kconfig
menu "Console Command: Iperf"

    config IPERF_CMD_DEFAULT_BW_MBPS
        bool "Use 'm' as default unit for '--bandwidth'"
        default n
        help
            This option is for compatibility with iperf 0.1, as the default bandwidth unit in iperf 0.1 is Mbps.

endmenu
```
