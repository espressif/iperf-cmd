## iperf/Kconfig
```kconfig
menu "Iperf"

    config IPERF_DEF_SOCKET_RX_TIMEOUT
        int "iperf socket TCP/UDP rx timeout in seconds"
        default 10
        help
            The value is used for iperf socket TCP/UDP rx timeout, iperf will be aborted
            and socket will be closed and shutdown.

    config IPERF_DEF_SOCKET_TCP_TX_TIMEOUT
        int "iperf socket TCP tx timeout in seconds"
        default 10
        help
            The value is used for iperf socket TCP tx timeout, iperf will be aborted
            and socket will be closed and shutdown.

    config IPERF_DEF_TRAFFIC_TASK_PRIORITY
        int "default iperf traffic task priority"
        default 4
        help
           The value is used for iperf traffic task priority.

    config IPERF_DEF_TRAFFIC_TASK_STACK
        int "default iperf traffic task stack size"
        default 4096
        help
           The value is used for iperf traffic task stack size.

    config IPERF_DEF_REPORT_TASK_PRIORITY
        int "iperf report task priority"
        default 10
        help
           The value is used for iperf report task priority.

    config IPERF_DEF_REPORT_TASK_STACK
        int "iperf report task stack size"
        default 4096
        help
           The value is used for iperf report task stack size.

    config IPERF_DEF_TCP_TX_BUFFER_LEN
        int "default tcp tx buffer length"
        default 16384 if (IDF_TARGET_LINUX || SPIRAM)
        default 2880
        help
           The value of default tcp tx buffer length.
           default smaller for chips if psram is not enabled.


    config IPERF_DEF_TCP_RX_BUFFER_LEN
        int "default tcp rx buffer length"
        default 16384 if (IDF_TARGET_LINUX || SPIRAM)
        default 2880
        help
           The value of default tcp rx buffer length.
           default smaller for chips if psram is not enabled.

    config IPERF_DEF_IPV4_UDP_TX_BUFFER_LEN
        int "default ipv4 udp tx buffer length"
        default 1470
        help
           The value of default ipv4 udp tx buffer length.

    config IPERF_DEF_IPV6_UDP_TX_BUFFER_LEN
        int "default ipv6 udp tx buffer length"
        default 1450
        help
           The value of default ipv6 udp tx buffer length.

    config IPERF_DEF_UDP_RX_BUFFER_LEN
        int "default udp rx buffer length"
        default 16384 if (IDF_TARGET_LINUX || SPIRAM)
        default 1500
        help
           The value of default udp rx buffer length.
           Not recommended to set the value too small due to udp does not support fragmentation.
           default smaller for chips if psram is not enabled.

    config IPERF_DEF_CLIENT_PENDING_TX_BURST
        int "Bandwidth-limited client: max packets per catch-up (when pacing runs late)"
        default 3
        range 1 100
        help
           When a bandwidth limit is set, the client paces sends with a periodic timer. If the
           traffic task is not scheduled for a while (for example while the report task prints
           statistics or the CPU is busy elsewhere), several timer periods can stack up before
           the next send. This option caps how many packets may be sent in one pass when
           catching up, so a delayed run does not turn into an unbounded burst.

           Lower values keep bursts smaller under load; higher values let the client recover
           average rate faster after a delay, but can stress network buffers and trigger ENOMEM
           on some setups even when the configured bandwidth is modest.

endmenu
```
